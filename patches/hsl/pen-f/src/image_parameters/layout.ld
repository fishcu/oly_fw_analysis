/* Copyright 2026 fishku (original contributions)
 * SPDX-License-Identifier: Apache-2.0
 * Scope and third-party exceptions: see RIGHTS-AND-PROVENANCE.md.
 */
SECTIONS { .color_hook 0x604f7506 : { *(.color_hook) } .extension 0x6069b2b0 : { *(.extension) } }
color_builder = 0x604f7272; color_resume = 0x604f750b; job_callback = 0x604c4011;
